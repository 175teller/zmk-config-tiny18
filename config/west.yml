## config/west.yml
```yaml
manifest:
  remotes:
    - name: zmkfirmware
      url-base: https://github.com/zmkfirmware
    - name: k3peta
      url-base: https://github.com/k3peta
    - name: caksoylar
      url-base: https://github.com/caksoylar
  
  projects:
    - name: zmk
      remote: zmkfirmware
      revision: main
      import: app/west.yml
    - name: zmk-rgbled-widget
      remote: caksoylar
      revision: main
    - name: zmk-config-tiny18
      remote: k3peta
      revision: main  # または最新commit
  self:
    path: config
```
